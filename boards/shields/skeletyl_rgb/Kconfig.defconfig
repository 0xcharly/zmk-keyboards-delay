## boards/shields/skeletyl_rgb/Kconfig.defconfig
```kconfig
# Copyright (c) 2022 ZMK Contributors
# SPDX-License-Identifier: MIT


if SHIELD_SKELETYL_RGB_LEFT

config ZMK_KEYBOARD_NAME
	default "Skeletyl RGB"

config ZMK_SPLIT_BLE_ROLE_CENTRAL
	default y

endif

if SHIELD_SKELETYL_RGB_RIGHT

config ZMK_KEYBOARD_NAME
	default "Skeletyl RGB Right"

endif

if SHIELD_SKELETYL_RGB_LEFT || SHIELD_SKELETYL_RGB_RIGHT

config ZMK_SPLIT
	default y

endif
```

## boards/shields/skeletyl_rgb/Kconfig.shield
```kconfig
# Copyright (c) 2020 ZMK Contributors
# SPDX-License-Identifier: MIT

config SHIELD_SKELETYL_RGB_LEFT
	def_bool $(shields_list_contains,skeletyl_rgb_left)

config SHIELD_SKELETYL_RGB_RIGHT
	def_bool $(shields_list_contains,skeletyl_rgb_right)
```
